## boards/shields/Test/Kconfig.defconfig
```kconfig
if SHIELD_COCON_R

config ZMK_KEYBOARD_NAME
    default "Cocon_R"

config ZMK_SPLIT
    default y

config ZMK_SPLIT_ROLE_CENTRAL
    default y

endif

if SHIELD_COCON_L

config ZMK_KEYBOARD_NAME
    default "Cocon_L"

config ZMK_SPLIT
    default y

endif
```

## boards/shields/Test/Kconfig.shield
```kconfig
config SHIELD_COCON_R
    def_bool $(shields_list_contains,Cocon_R)

config SHIELD_COCON_L
    def_bool $(shields_list_contains,Cocon_L)
```
